/**
  *******************************************************************
  * Chip: LPC11C12x301
  * NOTE: This file is generated by CoIDE and Included by link.ld
  *       It is used to describe which memory regions may be used
  *       by the linker.
  *******************************************************************
  * Internal memory map
  *   Region      Start           Size
  *   flash0      0x00000000      0x00004000
  *   sram0       0x10000100      0x00001F00
  *******************************************************************
*/

MEMORY
{
	rom (rx)  : ORIGIN = 0x00000000, LENGTH = 0x00004000
	ram (rwx) : ORIGIN = 0x10000100, LENGTH = 0x00001F00
}

_eram = 0x10000100 + 0x00001F00;